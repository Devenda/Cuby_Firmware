## main/Kconfig.projbuild
```kconfig
menu "Cuby Configuration"
    
    # For WiFi
    config WIFI_SSID
        string "WiFi SSID"
        default "myssid"
        help
            SSID (network name) for the example to connect to.

    config WIFI_PASSWORD
        string "WiFi Password"
        default "mypassword"
        help
            WiFi password (WPA or WPA2) for the example to use.

    config MAXIMUM_RETRY
        int "Maximum retry"
        default 5
        help
            Set the Maximum retry to avoid station reconnecting to the AP unlimited when the AP is really inexistent.

    config HOSTNAME
        string "mDNS Hostname"
        default "cuby"
        help
            mDNS Hostname

    # For OTA
    config FIRMWARE_UPGRADE_URL
        string "Firmware upgrade URL endpoint"
        default "https://firmware.lan:4433/firmware.bin"
        help
            URL of server which hosts the firmware
            image.

    # For LEDs
    config BLINK_GPIOA
        int "Blink GPIO number"
        range 0 34
        default 25
        help
            GPIO number (IOxx) to blink on and off.

            Some GPIOs are used for other purposes (flash connections, etc.) and cannot be used to blink.

            GPIOs 35-39 are input-only so cannot be used as outputs.

    config BLINK_GPIOB
        int "Blink GPIO number"
        range 0 34
        default 26
        help
            GPIO number (IOxx) to blink on and off.

            Some GPIOs are used for other purposes (flash connections, etc.) and cannot be used to blink.

            GPIOs 35-39 are input-only so cannot be used as outputs.

endmenu
```
